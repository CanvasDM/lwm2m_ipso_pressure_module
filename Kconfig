## Kconfig
```kconfig
#
# Copyright (c) 2022 Laird Connectivity LLC
#
# SPDX-License-Identifier: LicenseRef-LairdConnectivity-Clause
#
menuconfig LCZ_LWM2M_PRESSURE
	bool "Enable LwM2M Pressure Object"
	depends on LCZ_LWM2M_UTIL
	depends on LWM2M_IPSO_PRESSURE_SENSOR

if LCZ_LWM2M_PRESSURE

module=LCZ_LWM2M_PRESSURE
module-str=LWM2M_PRESSURE
source "subsys/logging/Kconfig.template.log_config"

endif # LCZ_LWM2M_PRESSURE
```
